## components/3rd_party/python3/Kconfig
```kconfig
# Python version major minor patch
menu "Python version"
  config PYTHON_VERSION_MAJOR
      int "python package major version"
      default 0
      help
        Python package major version, 0 means auto select according to board

  config PYTHON_VERSION_MINOR
      int "python package minor version"
      default 0
      help
        Python package minor version

  config PYTHON_VERSION_PATCH
      int "python package patch version"
      default 0
      help
        Python package patch version
endmenu

config PYTHON3_COMPILE_FROM_SOURCE
	bool "Cross-compile CPython from source (MaixCAM: replaces prebuilt musl libpython tarball)"
	default n
	help
	  When enabled for MaixCAM (and not using COMPONENTS_COMPILE_FROM_SOURCE for all libs),
	  the python3 component downloads the official Python CPython tarball (plus zlib/openssl
	  deps), cross-compiles libpython for the current toolchain, and links pybind/MaixPy
	  against that build instead of the prebuilt python3_lib_maixcam_musl package from
	  MaixCDK releases.

	  First builds are much slower; use host Python matching the target x.y (e.g. 3.11) to
	  avoid compiling a host Python for --with-build-python.
```

## components/rk_lib/Kconfig
```kconfig
config RK_LIB_COMPILE_FROM_SOURCE
	bool "Compile rk_lib from source (V4L2 + X11 shared library)"
	default y
	help
	  When enabled, MaixCDK builds librk_lib.so from maixcdk_rk_lib/src.
	  When disabled, place a prebuilt lib/librk_lib.so in components/rk_lib
	  so you can ship binaries without distributing implementation sources.

config RK_LIB_BUNDLED_X11
	bool "Build libX11 from MaixCDK x11_client (X.Org sources: libxcb + libX11, no apt libx11-dev)"
	default y
	depends on RK_LIB_COMPILE_FROM_SOURCE
	help
	  Uses components/3rd_party/x11_client (meson + autotools on host). Disable to link
	  system libX11 instead (native or multiarch/sysroot).
```
